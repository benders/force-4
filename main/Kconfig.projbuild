## main/Kconfig.projbuild
```kconfig
menu "Force-4 Configuration"
    config FORCE4_SD_CARD
        bool "Enable SD card support (XIAO Sense expansion board)"
        default n
        help
            Enable microSD card support via SPI on GPIO21 (CS).
            Requires the XIAO ESP32-S3 Sense expansion board.
    config FORCE4_CAMERA
        bool "Enable OV3660 camera (XIAO Sense expansion board)"
        depends on FORCE4_SD_CARD
        default n
        help
            Enable OV3660 camera support. Images are saved to the SD card (/sd/).
            Requires the XIAO ESP32-S3 Sense expansion board.
    choice FORCE4_VIDEO_RESOLUTION
        prompt "Video resolution"
        default FORCE4_VIDEO_SVGA
        depends on FORCE4_CAMERA
        config FORCE4_VIDEO_SVGA
            bool "SVGA (800x600, ~10 fps)"
        config FORCE4_VIDEO_QXGA
            bool "QXGA (2048x1536, ~2 fps)"
    endchoice
endmenu
```

## sdkconfig.defaults
```kconfig
CONFIG_IDF_TARGET="esp32s3"

# PSRAM (8MB OPI on XIAO ESP32-S3) — used for the log ring buffer so it is
# large enough to absorb the SPIFFS write deficit over a 60s flight at 800Hz.
CONFIG_SPIRAM=y
CONFIG_SPIRAM_MODE_OCT=y
CONFIG_SPIRAM_SPEED_80M=y

# Flash size
CONFIG_ESPTOOLPY_FLASHSIZE_8MB=y

# Console via built-in USB Serial/JTAG controller (hardware CDC-ACM).
# NOT USB_CDC (TinyUSB/OTG) — the XIAO ESP32-S3 wires USB to the
# Serial/JTAG controller, so USB_CDC has broken stdin.
CONFIG_ESP_CONSOLE_USB_SERIAL_JTAG=y

# Partition table
CONFIG_PARTITION_TABLE_CUSTOM=y
CONFIG_PARTITION_TABLE_CUSTOM_FILENAME="partitions.csv"

# SPIFFS
CONFIG_SPIFFS_MAX_PARTITIONS=1

# Task watchdog
CONFIG_ESP_TASK_WDT_TIMEOUT_S=10

# FreeRTOS tick rate (1ms ticks)
CONFIG_FREERTOS_HZ=1000

# Allow Core 1 (flight_task) to keep running during flash erases on Core 0.
# The MSPI controller suspends the erase when the CPU needs a cache fill,
# so FIFO reads are not stalled by SPIFFS sector erases.
# Compatible with CONFIG_SPIRAM — do not use EXT_RAM_BSS_ATTR (see CLAUDE.md).
CONFIG_SPI_FLASH_AUTO_SUSPEND=y

# SD card support (XIAO Sense expansion board, CS=GPIO21 on SPI2_HOST)
CONFIG_FORCE4_SD_CARD=y

# Camera support (OV3660 on XIAO Sense board, uses LEDC_TIMER_1/CHANNEL_1 for XCLK)
CONFIG_FORCE4_CAMERA=y
```
